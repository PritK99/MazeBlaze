## firmware/6_turn_and_line_follow/main/Kconfig
```kconfig
menu "MazeBlaze Configuration"

menu "WiFi Config"
    config WIFI_SSID
        string "WiFi SSID"
        default "Galaxy M3162C8"
        help
            SSID (network name) for the example to connect to.

    config WIFI_PASSWORD
        string "WiFi Password"
        default "chindada"
        help
            WiFi password (WPA or WPA2) for the example to use.

    config MAXIMUM_RETRY
        int "Maximum retry"
        default 5
        help
            Set the Maximum retry to avoid station reconnecting to the AP unlimited when the AP is really inexistent.
endmenu

menu "mDNS Config"
    config MDNS_HOST_NAME
        string "mDNS host name (< 15 chars)"
        default "mazeblaze-tuning"
        help
            mDNS hostname used to access the tuning webpage, it should be less than 15 chars
endmenu

endmenu
```

## firmware/components/Kconfig
```kconfig
menu "SRA Board Component Config"
config NUMBER_OF_SAMPLES
    int "Number of samples for multisampling ADC values to use with LSA"
    default 5
    help
        sets the number of ADC samples to average to use with LSA
        
endmenu
```
